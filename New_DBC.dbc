VERSION ""

NS_ :

BS_:

BU_: XXX

BO_ 276 NEW_MSG_1: 8 XXX

BO_ 292 NEW_MSG_2: 8 XXX
 SG_ RPM : 15|16@0+ (1,0) [0|6000] "" XXX

BO_ 288 NEW_MSG_3: 8 XXX

BO_ 290 NEW_MSG_4: 8 XXX
 SG_ Gas : 15|16@0+ (1,0) [0|65535] "" XXX

BO_ 440 NEW_MSG_5: 8 XXX
 SG_ Speed : 7|16@0+ (1,0) [0|65535] "" XXX

BO_ 319 NEW_MSG_6: 8 XXX
 SG_ NEW_SIGNAL_1 : 15|16@0+ (1,0) [0|65535] "" XXX

BO_ 495 NEW_MSG_7: 8 XXX
 SG_ NEW_SIGNAL_1 : 47|10@0+ (1,0) [0|1023] "" XXX
 SG_ steer_torque : 15|24@0+ (1,0) [0|65535] "" XXX

BO_ 672 NEW_MSG_8: 8 XXX
 SG_ NEW_SIGNAL_1 : 3|12@0+ (1,0) [0|255] "" XXX
