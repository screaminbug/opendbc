VERSION ""

NS_ :

BS_:

BU_: XXX

BO_ 1664 Radar_1: 8 XXX
 SG_ Distance : 0|20@1- (1,0) [0|127] "" XXX
 SG_ Speed_Difference : 19|23@1+ (1,0) [0|65535] "" XXX
 SG_ Lateral : 48|8@1+ (1,0) [0|3] "" XXX
 SG_ NEW_SIGNAL_1 : 47|6@0+ (1,0) [0|63] "" XXX
 SG_ NEW_SIGNAL_2 : 56|8@1+ (1,0) [0|3] "" XXX
